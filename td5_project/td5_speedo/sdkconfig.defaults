## td5_project/td5_speedo/sdkconfig.defaults
```kconfig
# Based on manufacturer's lvgl_demo_v9 sdkconfig.defaults
# with additions for USB Host and TD5 speedometer fonts

CONFIG_IDF_TARGET="esp32p4"
CONFIG_ESP32P4_SELECTS_REV_LESS_V3=y
CONFIG_ESP32P4_REV_MIN_100=y
CONFIG_ESPTOOLPY_FLASHMODE_QIO=y
CONFIG_ESPTOOLPY_FLASHSIZE_16MB=y
CONFIG_PARTITION_TABLE_CUSTOM=y
CONFIG_COMPILER_OPTIMIZATION_PERF=y

# PSRAM (32MB on this board)
CONFIG_SPIRAM=y
CONFIG_SPIRAM_SPEED_200M=y
CONFIG_SPIRAM_XIP_FROM_PSRAM=y

# Cache settings for MIPI-DSI performance
CONFIG_CACHE_L2_CACHE_256KB=y
CONFIG_CACHE_L2_CACHE_LINE_128B=y

# Task config
CONFIG_ESP_MAIN_TASK_STACK_SIZE=10240
CONFIG_FREERTOS_HZ=1000

# USB Host support
CONFIG_USB_OTG_SUPPORTED=y
CONFIG_USB_HOST_HUBS_SUPPORTED=y

# LVGL core settings
CONFIG_LV_USE_CLIB_MALLOC=y
CONFIG_LV_USE_CLIB_STRING=y
CONFIG_LV_USE_CLIB_SPRINTF=y
CONFIG_LV_DEF_REFR_PERIOD=15
CONFIG_LV_OS_FREERTOS=y
CONFIG_LV_DRAW_SW_DRAW_UNIT_CNT=2
CONFIG_LV_ATTRIBUTE_FAST_MEM_USE_IRAM=y

# LVGL fonts needed for the speedometer
CONFIG_LV_FONT_MONTSERRAT_12=y
CONFIG_LV_FONT_MONTSERRAT_16=y
CONFIG_LV_FONT_MONTSERRAT_18=y
CONFIG_LV_FONT_MONTSERRAT_20=y
CONFIG_LV_FONT_MONTSERRAT_22=y
CONFIG_LV_FONT_MONTSERRAT_24=y
CONFIG_LV_FONT_MONTSERRAT_26=y
CONFIG_LV_FONT_MONTSERRAT_48=y
CONFIG_LV_USE_FONT_COMPRESSED=y
CONFIG_LV_FONT_FMT_TXT_LARGE=y

# Experimental features (needed for ESP32-P4 MIPI-DSI)
CONFIG_IDF_EXPERIMENTAL_FEATURES=y

# LCD type: 480x800 ST7701 panel (BSP calls it "1024_600" but resolution is 480x800)
CONFIG_BSP_LCD_TYPE_1024_600=y
```
